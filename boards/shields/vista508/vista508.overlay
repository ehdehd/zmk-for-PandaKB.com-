/*
 * Copyright (c) 2022 The ZMK Contributors
 *
 * SPDX-License-Identifier: MIT
 */

&spi0 {
    status = "okay";
    vista508: ls0xx@0 {
        compatible = "sharp,ls0xx-vcom";
        spi-max-frequency = <1000000>;
        serial-vcom-inversion;
        serial-vcom-interval = <17>;
        reg = <0>;
        width = <144>;
        height = <168>;
    };
};

/ {
    chosen {
        zephyr,display = &vista508;
    };
};
