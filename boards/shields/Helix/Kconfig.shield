## boards/shields/Helix/Kconfig.shield
```kconfig
# Copyright (c) 2020 Pete Johanson
# SPDX-License-Identifier: MIT

config SHIELD_HELIX_L
	def_bool $(shields_list_contains,Helix_L)

config SHIELD_HELIX_R
	def_bool $(shields_list_contains,Helix_R)
```

## boards/shields/Klor/Kconfig.shield
```kconfig
# Copyright (c) 2020 Pete Johanson
# SPDX-License-Identifier: MIT

config SHIELD_KLOR_LEFT
	def_bool $(shields_list_contains,Klor_left)

config SHIELD_KLOR_RIGHT
	def_bool $(shields_list_contains,Klor_right)
```

## boards/shields/Klor_dongle/Kconfig.shield
```kconfig
# Copyright (c) 2020 The ZMK Contributors
# SPDX-License-Identifier: MIT

config SHIELD_KLOR_DONGLE_CENTRAL
    def_bool $(shields_list_contains,Klor_dongle_central)

config SHIELD_KLOR_DONGLE_LEFT
    def_bool $(shields_list_contains,Klor_dongle_left)

config SHIELD_KLOR_DONGLE_RIGHT
    def_bool $(shields_list_contains,Klor_dongle_right)
```

## boards/shields/Lily58/Kconfig.shield
```kconfig
# Copyright (c) 2020 The ZMK Contributors
# SPDX-License-Identifier: MIT

config SHIELD_LILY58_CENTRAL
    def_bool $(shields_list_contains,Lily58_central)

config SHIELD_LILY58_LEFT
    def_bool $(shields_list_contains,Lily58_left)

config SHIELD_LILY58_RIGHT
    def_bool $(shields_list_contains,Lily58_right)
```

## boards/shields/Sofle/Kconfig.defconfig
```kconfig
if SHIELD_SOFLE_CENTRAL
    config ZMK_KEYBOARD_NAME
        default "Sofle"
    config ZMK_SPLIT_ROLE_CENTRAL
        default y
    config ZMK_SPLIT_BLE_CENTRAL_PERIPHERALS
        default 2
    config BT_MAX_CONN
        default 5
    config BT_MAX_PAIRED
        default 5
    
    if ZMK_DISPLAY
        config I2C
            default y
        config SSD1306
            default y
        choice ZMK_DISPLAY_WORK_QUEUE
            default ZMK_DISPLAY_WORK_QUEUE_DEDICATED
        endchoice
    endif
        
    if SSD1306
        config LV_Z_VDB_SIZE
            default 64
        config LV_DPI_DEF
            default 148
        config LV_Z_BITS_PER_PIXEL
            default 1
        choice LV_COLOR_DEPTH
            default LV_COLOR_DEPTH_1
        endchoice
    endif

endif

if SHIELD_SOFLE_LEFT || SHIELD_SOFLE_RIGHT
    config ZMK_SPLIT_ROLE_CENTRAL
        default n
endif

if SHIELD_SOFLE_LEFT || SHIELD_SOFLE_RIGHT || SHIELD_SOFLE_CENTRAL
    config ZMK_SPLIT
        default y
endif
```

## config/west.yml
```yaml
manifest:
  remotes:
    - name: zmkfirmware
      url-base: https://github.com/zmkfirmware
  #additional module
    - name: mctechnology17
      url-base: https://github.com/mctechnology17
    - name: m165437
      url-base: https://github.com/M165437
    - name: englmaxi
      url-base: https://github.com/englmaxi
      
  projects:
    - name: zmk
      remote: zmkfirmware
      revision: main
      import: app/west.yml
  #additional module
    - name: zmk-nice-oled
      remote: mctechnology17
      revision: main
    - name: nice-view-gem
      remote: m165437
      revision: main
    - name: zmk-dongle-display
      remote: englmaxi
      revision: main
      
  self:
    path: config
```
